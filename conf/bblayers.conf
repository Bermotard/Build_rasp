## conf/bblayers.conf
```bitbake
# POKY_BBLAYERS_CONF_VERSION is increased each time build/conf/bblayers.conf
# changes incompatibly
POKY_BBLAYERS_CONF_VERSION = "2"

BBPATH = "${TOPDIR}"
BBFILES ?= ""
YOCTOROOT = "${@os.path.abspath(os.path.join("${TOPDIR}", os.pardir))}"

BBLAYERS ?= " \
  ${YOCTOROOT}/meta \
  ${YOCTOROOT}/meta-poky \
  ${YOCTOROOT}/meta-yocto-bsp \
  ${YOCTOROOT}/meta-raspberrypi \
  ${YOCTOROOT}/meta-openembedded/meta-oe \
  ${YOCTOROOT}/meta-openembedded/meta-multimedia \
  ${YOCTOROOT}/meta-openembedded/meta-networking \
  ${YOCTOROOT}/meta-openembedded/meta-python \
  ${YOCTOROOT}/meta-openembedded/meta-perl \
  ${YOCTOROOT}/meta-openembedded/meta-gnome \
  ${YOCTOROOT}/meta-openembedded/meta-xfce \
  ${YOCTOROOT}/meta-selinux \
  ${YOCTOROOT}/meta-96boards \
  "
```
